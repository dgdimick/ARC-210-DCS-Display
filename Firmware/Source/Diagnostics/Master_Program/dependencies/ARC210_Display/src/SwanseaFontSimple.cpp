#include <Arduino.h>
#include <ILI9488_t3.h>
#include "SwanseaFontSimple.h"

extern ILI9488_t3 tft;

static constexpr uint8_t SWANSEA_FIRST = 32;
static constexpr uint8_t SWANSEA_LAST  = 126;

const uint32_t Swansea28Rows[] PROGMEM =
{
    0x0000001CUL, 0x0000001CUL, 0x0000001CUL, 0x0000001CUL, 0x0000001CUL, 0x0000001CUL,
    0x0000001CUL, 0x0000001CUL, 0x00000018UL, 0x00000018UL, 0x00000018UL, 0x00000018UL,
    0x00000018UL, 0x00000018UL, 0x00000018UL, 0x00000000UL, 0x00000000UL, 0x00000000UL,
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    0x00000000UL, 0x00000000UL, 0x00000000UL,
};

const SwanseaSimpleGlyph Swansea28GlyphsSimple[] PROGMEM =
{
    {0, 8, 0, 8, 0, 0}, // ' '
    {0, 8, 20, 8, 0, -20}, // '!'
    {20, 10, 20, 10, 0, -20}, // '"'
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    {1751, 16, 10, 16, 0, -10}, // '~'
};

// ==================================================
// DRAW ONE SWANSEA CHARACTER
// ==================================================
/// ==================================================
// DRAW ONE SWANSEA CHARACTER
// Supports fractional scaling
// ==================================================
static void drawSwanseaChar(
    int16_t x,
    int16_t baselineY,
    char c,
    float scale,
    uint16_t color
)
{
    if (c < SWANSEA_FIRST || c > SWANSEA_LAST)
    {
        return;
    }

    uint8_t index = (uint8_t)c - SWANSEA_FIRST;

    SwanseaSimpleGlyph g;

    memcpy_P(
        &g,
        &Swansea28GlyphsSimple[index],
        sizeof(SwanseaSimpleGlyph)
    );

    for (uint8_t row = 0; row < g.height; row++)
    {
        uint32_t bits =
            pgm_read_dword(
                &Swansea28Rows[g.rowOffset + row]
            );

        for (uint8_t col = 0; col < g.width; col++)
        {
            if (bits & (1UL << col))
            {
                int16_t x1 =
                    x + roundf(
                        (g.xOffset + col) * scale
                    );

                int16_t x2 =
                    x + roundf(
                        (g.xOffset + col + 1) * scale
                    );

                int16_t y1 =
                    baselineY + roundf(
                        (g.yOffset + row) * scale
                    );

                int16_t y2 =
                    baselineY + roundf(
                        (g.yOffset + row + 1) * scale
                    );

                int16_t pixelWidth = x2 - x1;
                int16_t pixelHeight = y2 - y1;

                if (pixelWidth < 1)
                {
                    pixelWidth = 1;
                }

                if (pixelHeight < 1)
                {
                    pixelHeight = 1;
                }

                tft.fillRect(
                    x1,
                    y1,
                    pixelWidth,
                    pixelHeight,
                    color
                );
            }
        }
    }
}


// ==================================================
// DRAW SWANSEA STRING
// Supports fractional scaling
// ==================================================
void drawSwanseaText(
    int16_t x,
    int16_t baselineY,
    const char* text,
    float scale,
    uint16_t color
)
{
    if (text == nullptr || scale <= 0.0f)
    {
        return;
    }

    while (*text)
    {
        char c = *text++;

        if (c == '\n')
        {
            x = 0;
            baselineY += roundf(34.0f * scale);
            continue;
        }

        if (c < SWANSEA_FIRST || c > SWANSEA_LAST)
        {
            continue;
        }

        uint8_t index =
            (uint8_t)c - SWANSEA_FIRST;

        SwanseaSimpleGlyph g;

        memcpy_P(
            &g,
            &Swansea28GlyphsSimple[index],
            sizeof(SwanseaSimpleGlyph)
        );

        drawSwanseaChar(
            x,
            baselineY,
            c,
            scale,
            color
        );

        x += roundf(
            g.xAdvance * scale
        );
    }
}


// ==================================================
// GET SWANSEA STRING WIDTH
// Supports fractional scaling
// ==================================================
int16_t getSwanseaTextWidth(
    const char* text,
    float scale
)
{
    if (text == nullptr || scale <= 0.0f)
    {
        return 0;
    }

    int16_t width = 0;

    while (*text)
    {
        char c = *text++;

        if (c < SWANSEA_FIRST || c > SWANSEA_LAST)
        {
            continue;
        }

        uint8_t index =
            (uint8_t)c - SWANSEA_FIRST;

        SwanseaSimpleGlyph g;

        memcpy_P(
            &g,
            &Swansea28GlyphsSimple[index],
            sizeof(SwanseaSimpleGlyph)
        );

        width += roundf(
            g.xAdvance * scale
        );
    }

    return width;
}