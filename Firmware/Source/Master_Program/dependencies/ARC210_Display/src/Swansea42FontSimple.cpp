#include <Arduino.h>
#include <ILI9488_t3.h>
#include "Swansea42FontSimple.h"

extern ILI9488_t3 tft;

static constexpr uint8_t SWANSEA42_FIRST = 32;
static constexpr uint8_t SWANSEA42_LAST  = 126;

const uint64_t Swansea42Rows[] PROGMEM =
{
    0x00000000000000F0ULL, 0x00000000000000F0ULL, 0x00000000000000F0ULL, 0x00000000000000F0ULL,
    0x00000000000000F0ULL, 0x00000000000000F0ULL, 0x00000000000000F0ULL, 0x00000000000000F0ULL,
    0x00000000000000F0ULL, 0x00000000000000F0ULL, 0x00000000000000F0ULL, 0x00000000000000F0ULL,
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    0x0000000000000000ULL,
};

const Swansea42SimpleGlyph Swansea42GlyphsSimple[] PROGMEM =
{
    {0, 12, 0, 12, 0, 0}, // ' '
    {0, 12, 30, 12, 0, -30}, // '!'
    {30, 15, 30, 15, 0, -30}, // '"'
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    {2613, 25, 16, 25, 0, -16}, // '~'
};

static void drawSwansea42Char(
    int16_t x,
    int16_t baselineY,
    char c,
    uint16_t color
)
{
    if (c < SWANSEA42_FIRST || c > SWANSEA42_LAST)
        return;

    uint8_t index = (uint8_t)c - SWANSEA42_FIRST;

    Swansea42SimpleGlyph g;
    memcpy_P(
        &g,
        &Swansea42GlyphsSimple[index],
        sizeof(Swansea42SimpleGlyph)
    );

    for (uint8_t row = 0; row < g.height; row++)
    {
        uint64_t bits;

memcpy_P(
    &bits,
    &Swansea42Rows[g.rowOffset + row],
    sizeof(bits)
);

for (uint8_t col = 0; col < g.width; col++)
        {
            if (bits & (1ULL << col))
            {
                tft.drawPixel(
                    x + g.xOffset + col,
                    baselineY + g.yOffset + row,
                    color
                );
            }
        }
    }
}

void drawSwansea42Text(
    int16_t x,
    int16_t baselineY,
    const char* text,
    uint16_t color
)
{
    if (text == nullptr)
        return;

    while (*text)
    {
        char c = *text++;

        if (c == '\n')
        {
            x = 0;
            baselineY += 50;
            continue;
        }

        if (c < SWANSEA42_FIRST || c > SWANSEA42_LAST)
            continue;

        uint8_t index = (uint8_t)c - SWANSEA42_FIRST;

        Swansea42SimpleGlyph g;
        memcpy_P(
            &g,
            &Swansea42GlyphsSimple[index],
            sizeof(Swansea42SimpleGlyph)
        );

        drawSwansea42Char(
            x,
            baselineY,
            c,
            color
        );

        x += g.xAdvance;
    }
}

int16_t getSwansea42TextWidth(const char* text)
{
    if (text == nullptr)
        return 0;

    int16_t width = 0;

    while (*text)
    {
        char c = *text++;

        if (c < SWANSEA42_FIRST || c > SWANSEA42_LAST)
            continue;

        uint8_t index = (uint8_t)c - SWANSEA42_FIRST;

        Swansea42SimpleGlyph g;
        memcpy_P(
            &g,
            &Swansea42GlyphsSimple[index],
            sizeof(Swansea42SimpleGlyph)
        );

        width += g.xAdvance;
    }

    return width;
}
